## samples/tracker/Kconfig
```kconfig
#
# Copyright (c) 2021 Circuit Dojo LLC
#
# SPDX-License-Identifier: LicenseRef-Circuit-Dojo-5-Clause
#

mainmenu "Tracker Demo Application"

config DISCONNECT_FOR_FIRST_FIX
	bool "Major verison number"
	default false

config USE_LED_INDICATION
	bool "Turns on default LED indication events"
	default true

config GPS_CONTINUOUS_SAVE_RATE
	int "Define a variable to control how often GPS data is saved from the main app when GPS is continuous"
	default 5

rsource "src/version/Kconfig"
rsource "src/gps/Kconfig"
rsource "src/storage/Kconfig"

source "Kconfig.zephyr"
```
